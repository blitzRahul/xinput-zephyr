## CMakeLists.txt
```
# SPDX-License-Identifier: Apache-2.0

cmake_minimum_required(VERSION 3.20.0)
find_package(Zephyr REQUIRED HINTS $ENV{ZEPHYR_BASE})
project(xinput-middleware)

target_include_directories(app PRIVATE ${ZEPHYR_BASE}/subsys/usb)

FILE(GLOB app_sources src/*.c)
target_sources(app PRIVATE ${app_sources})
```

## prj.conf
```kconfig
CONFIG_STDOUT_CONSOLE=y
CONFIG_USB_DEVICE_STACK=y
#CONFIG_USB_DEVICE_BOS=y
CONFIG_SERIAL=y
CONFIG_USB_DEVICE_MANUFACTURER="Michaelsoft"
CONFIG_USB_DEVICE_PRODUCT="YBox360"
CONFIG_USB_DEVICE_VID=0x0170
CONFIG_USB_DEVICE_PID=0xAA80
CONFIG_UART_INTERRUPT_DRIVEN=y
CONFIG_UART_LINE_CTRL=y
CONFIG_USB_DEVICE_INITIALIZE_AT_BOOT=n

CONFIG_LOG=y
CONFIG_USB_DRIVER_LOG_LEVEL_DBG=y
CONFIG_USB_DEVICE_LOG_LEVEL_DBG=y
CONFIG_LOG_BUFFER_SIZE=10240
CONFIG_LOG_BACKEND_SHOW_COLOR=y
CONFIG_LOG_DBG_COLOR_BLUE=y
```

## src/main.c
```c
/*
 * Copyright (c) 2016-2019 Intel Corporation
 * Copyright (c) 2023 Nordic Semiconductor ASA
 *
 * SPDX-License-Identifier: Apache-2.0
 */

/**
 * @file
 * @brief Sample app for WebUSB enabled custom class driver.
 *
 * Sample app for WebUSB enabled custom class driver. The received
 * data is echoed back to the WebUSB based application running in
 * the browser at host.
 */

#define LOG_LEVEL CONFIG_USB_DEVICE_LOG_LEVEL
#include <zephyr/logging/log.h>
LOG_MODULE_REGISTER(main, LOG_LEVEL_DBG);

#include <zephyr/sys/byteorder.h>
#include <zephyr/usb/usb_device.h>
#include <zephyr/usb/bos.h>
#include <zephyr/usb/msos_desc.h>

#include "webusb.h"




/* Predefined response to control commands related to MS OS 1.0 descriptors
 * Please note that this code only defines "extended compat ID OS feature
 * descriptors" and not "extended properties OS features descriptors"
 */
#define MSOS_STRING_LENGTH	18
static struct string_desc {
	uint8_t bLength;
	uint8_t bDescriptorType;
	uint8_t bString[MSOS_STRING_LENGTH];

} __packed msos1_string_descriptor = {
	.bLength = MSOS_STRING_LENGTH,
	.bDescriptorType = USB_DESC_STRING,
	/* Signature MSFT100 */
	.bString = {
		'M', 0x00, 'S', 0x00, 'F', 0x00, 'T', 0x00,
		'1', 0x00, '0', 0x00, '0', 0x00,
		0x17, /* Vendor Code, used for a control request */
		0x00, /* Padding byte for VendorCode looks like UTF16 */
	},
};

static const uint8_t msos1_compatid_descriptor[] = {
	/* See https://github.com/pbatard/libwdi/wiki/WCID-Devices */
	/* MS OS 1.0 header section */
	0x28, 0x00, 0x00, 0x00, /* Descriptor size (40 bytes)          */
	0x00, 0x01,             /* Version 1.00                        */
	0x04, 0x00,             /* Type: Extended compat ID descriptor */
	0x01,                   /* Number of function sections         */
	0x00, 0x00, 0x00, 0x00, 0x00, 0x00, 0x00,       /* reserved    */

	/* MS OS 1.0 function section */
	0x02,     /* Index of interface this section applies to. */
	0x01,     /* reserved */
	/* 8-byte compatible ID string, then 8-byte sub-compatible ID string */
	'X',  'U',  'S',  'B',  '1',  '0',  0x00, 0x00,
	0x00, 0x00, 0x00, 0x00, 0x00, 0x00, 0x00, 0x00,
	0x00, 0x00, 0x00, 0x00, 0x00, 0x00 /* reserved */
};


/**
 * @brief Custom handler for standard requests in
 *        order to catch the request and return the
 *        WebUSB Platform Capability Descriptor.
 *
 * @param pSetup    Information about the request to execute.
 * @param len       Size of the buffer.
 * @param data      Buffer containing the request result.
 *
 * @return  0 on success, negative errno code on fail
 */
int custom_handle_req(struct usb_setup_packet *pSetup,
		      int32_t *len, uint8_t **data)
{
	if (usb_reqtype_is_to_device(pSetup)) {
		LOG_ERR("reqtype to host not supported");
		return -ENOTSUP;
	}

	if (USB_GET_DESCRIPTOR_TYPE(pSetup->wValue) == USB_DESC_STRING &&
	    USB_GET_DESCRIPTOR_INDEX(pSetup->wValue) == 0xEE) {
		*data = (uint8_t *)(&msos1_string_descriptor);
		*len = sizeof(msos1_string_descriptor);

		LOG_DBG("Get MS OS Descriptor v1 string");

		return 0;
	}

	LOG_ERR("Returning -EINVAL");
	return -EINVAL;
}

/**
 * @brief Handler called for vendor specific commands. This includes
 *        WebUSB allowed origins and MS OS 1.0 and 2.0 descriptors.
 *
 * @param pSetup    Information about the request to execute.
 * @param len       Size of the buffer.
 * @param data      Buffer containing the request result.
 *
 * @return  0 on success, negative errno code on fail.
 */
int vendor_handle_req(struct usb_setup_packet *pSetup,
		      int32_t *len, uint8_t **data)
{
	if (usb_reqtype_is_to_device(pSetup)) {
		return -ENOTSUP;
	}

	 if (pSetup->bRequest == 0x17 && pSetup->wIndex == 0x04) {
		/* Get MS OS 1.0 Descriptors request */
		/* 0x04 means "Extended compat ID".
		 * Use 0x05 instead for "Extended properties".
		 */
		*data = (uint8_t *)(&msos1_compatid_descriptor);
		*len = sizeof(msos1_compatid_descriptor);

		LOG_DBG("Get MS OS Descriptors CompatibleID");

		return 0;
	}

	return -ENOTSUP;
}

/* Custom and Vendor request handlers */
static struct webusb_req_handlers req_handlers = {
	.custom_handler = custom_handle_req,
	.vendor_handler = vendor_handle_req,
};

int main(void)
{
	int ret;

	LOG_DBG("");


	/* Set the custom and vendor request handlers */
	webusb_register_request_handlers(&req_handlers);

	ret = usb_enable(NULL);
	if (ret != 0) {
		LOG_ERR("Failed to enable USB");
		return 0;
	}
	return 0;
}
```

## src/webusb.c
```c
/*
 * Copyright (c) 2015-2019 Intel Corporation
 *
 * SPDX-License-Identifier: Apache-2.0
 */

/**
 * @file
 * @brief WebUSB enabled custom class driver
 *
 * This is a modified version of CDC ACM class driver
 * to support the WebUSB.
 */

#define LOG_LEVEL CONFIG_USB_DEVICE_LOG_LEVEL
#include <zephyr/logging/log.h>
LOG_MODULE_REGISTER(webusb);

#include <zephyr/sys/byteorder.h>
#include <zephyr/usb/usb_device.h>
#include <usb_descriptor.h>

#include "webusb.h"

/* Max packet size for Bulk endpoints */
#if defined(CONFIG_USB_DC_HAS_HS_SUPPORT)
#define WEBUSB_BULK_EP_MPS		512
#else
#define WEBUSB_BULK_EP_MPS		32
#endif

/* Number of interfaces */
#define WEBUSB_NUM_ITF			0x01
/* Number of Endpoints in the custom interface */
#define WEBUSB_NUM_EP			0x02

#define WEBUSB_IN_EP_IDX		0
#define WEBUSB_OUT_EP_IDX		1

static struct webusb_req_handlers *req_handlers;
static struct xinput_in_struct{
	uint8_t report_id;
	uint8_t report_size;
	uint8_t buttons_0;
	uint8_t buttons_1;
	uint8_t lz;
	uint8_t rz;
	int16_t lx;
	int16_t ly;
	int16_t rx;
	int16_t ry;
	uint8_t reserved[6];
} __packed xinput_data = {
	.report_id   = 0,
	.report_size = 20,
	.buttons_0   = 0,
	.buttons_1   = 0,
	.lz          = 0,
	.rz          = 0,
	.lx          = 0,
	.ly          = 0,
	.rx          = 0,
	.ry          = 0,
	.reserved    = {0, 0, 0, 0, 0, 0}
};


uint8_t rx_buf[WEBUSB_BULK_EP_MPS];

#define INITIALIZER_IF(num_ep)				\
	{								\
		.bLength = sizeof(struct usb_if_descriptor),		\
		.bDescriptorType = USB_DESC_INTERFACE,			\
		.bInterfaceNumber = 0,					\
		.bAlternateSetting = 0,					\
		.bNumEndpoints = num_ep,				\
		.bInterfaceClass = 0xFF,				\
		.bInterfaceSubClass = 0x5D,				\
		.bInterfaceProtocol = 0x01,				\
		.iInterface = 0,					\
	}

#define INITIALIZER_IF_EP(addr, attr, mps, interval)			\
	{								\
		.bLength = 0x07,		\
		.bDescriptorType = USB_DESC_ENDPOINT,			\
		.bEndpointAddress = addr,				\
		.bmAttributes = attr,					\
		.wMaxPacketSize = sys_cpu_to_le16(mps),			\
		.bInterval = interval,					\
	}

//0x10, 0x21, 0x10, 0x01, 0x01, 0x24, 0x81, 0x14, 0x03, 0x00, 0x03, 0x13, 0x02, 0x00, 0x03, 0x00,
USBD_CLASS_DESCR_DEFINE(primary, 0) struct {
	struct usb_if_descriptor if0;
	struct usb_ep_descriptor if0_in_ep;
	struct xbox_undefined_descriptor vndr;
	struct usb_ep_descriptor if0_out_ep;
	
} __packed webusb_desc = {
	.if0 = INITIALIZER_IF(0x02),
	.vndr = {
		.bLength = 0x10,
		.bDescriptorType = 0x21,
		.f1 = 0x10,
		.f2 = 0x01,
		.f3 = 0x01,
		.f4 = 0x24,
		.f5 = 0x81,
		.f6 = 0x14,
		.f7 = 0x03,
		.f8 = 0x00,
		.f9 = 0x03,
		.f10 = 0x13,
		.f11 = 0x01,
		.f12 = 0x00,
		.f13 = 0x03,
		.f14 = 0x00
	},
	.if0_in_ep = INITIALIZER_IF_EP(0x81, USB_DC_EP_INTERRUPT,
				       32, 0x04),
	.if0_out_ep = INITIALIZER_IF_EP(0x01, USB_DC_EP_INTERRUPT,
					32, 0x08),

};

/**
 * @brief Custom handler for standard requests in order to
 *        catch the request and return the WebUSB Platform
 *        Capability Descriptor.
 *
 * @param pSetup    Information about the request to execute.
 * @param len       Size of the buffer.
 * @param data      Buffer containing the request result.
 *
 * @return  0 on success, negative errno code on fail.
 */
int webusb_custom_handle_req(struct usb_setup_packet *pSetup,
			     int32_t *len, uint8_t **data)
{
	LOG_DBG("");

	/* Call the callback */
	if (req_handlers && req_handlers->custom_handler) {
		return req_handlers->custom_handler(pSetup, len, data);
	}

	return -EINVAL;
}

/**
 * @brief Handler called for WebUSB vendor specific commands.
 *
 * @param pSetup    Information about the request to execute.
 * @param len       Size of the buffer.
 * @param data      Buffer containing the request result.
 *
 * @return  0 on success, negative errno code on fail.
 */
int webusb_vendor_handle_req(struct usb_setup_packet *pSetup,
			     int32_t *len, uint8_t **data)
{
	/* Call the callback */
	if (req_handlers && req_handlers->vendor_handler) {
		return req_handlers->vendor_handler(pSetup, len, data);
	}

	return -EINVAL;
}

/**
 * @brief Register Custom and Vendor request callbacks
 *
 * This function registers Custom and Vendor request callbacks
 * for handling the device requests.
 *
 * @param [in] handlers Pointer to WebUSB request handlers structure
 */
void webusb_register_request_handlers(struct webusb_req_handlers *handlers)
{
	req_handlers = handlers;
}

void xinput_out_cb(uint8_t ep, enum usb_dc_ep_cb_status_code ep_status)
{
	LOG_DBG("Out");
}

static int ctr=0;
 void xinput_in_cb(uint8_t ep, enum usb_dc_ep_cb_status_code ep_status)
{
	if(ctr==50){
		xinput_data.buttons_1 = 0b00010000;
		xinput_data.lx = -32000;
		xinput_data.ry = -32000;
		xinput_data.lz=255;
	}
	if(ctr==100){
		xinput_data.buttons_1 = 0x00;
		xinput_data.lx = 32000;
		xinput_data.ry = 32000;
		xinput_data.lz=0;
		ctr=0;
	}
	ctr+=1;
	if (usb_write(ep, (const uint8_t *)&xinput_data, sizeof xinput_data, NULL)) {
		LOG_INF("data IN success");
	}
}
/* Describe EndPoints configuration */
static struct usb_ep_cfg_data webusb_ep_data[] = {
	{
		.ep_cb = xinput_in_cb,
		.ep_addr = 0x81
	},
	{
		.ep_cb	= xinput_out_cb,
		.ep_addr = 0x01
	}
};

/**
 * @brief Callback used to know the USB connection status
 *
 * @param status USB device status code.
 */
static void webusb_dev_status_cb(struct usb_cfg_data *cfg,
				 enum usb_dc_status_code status,
				 const uint8_t *param)
{
	ARG_UNUSED(param);
	ARG_UNUSED(cfg);

	/* Check the USB status and do needed action if required */
	switch (status) {
	case USB_DC_ERROR:
		LOG_DBG("USB device error");
		break;
	case USB_DC_RESET:
		LOG_DBG("USB device reset detected");
		break;
	case USB_DC_CONNECTED:
		LOG_DBG("USB device connected");
		break;
	case USB_DC_CONFIGURED:
		LOG_INF("USB device configured");
		xinput_in_cb(webusb_ep_data[0].ep_addr, 0);
		break;
	case USB_DC_DISCONNECTED:
		LOG_DBG("USB device disconnected");
		break;
	case USB_DC_SUSPEND:
		LOG_DBG("USB device suspended");
		break;
	case USB_DC_RESUME:
		LOG_DBG("USB device resumed");
		break;
	case USB_DC_UNKNOWN:
	default:
		LOG_DBG("USB unknown state");
		break;
	}
}





USBD_DEFINE_CFG_DATA(webusb_config) = {
	.usb_device_description = NULL,
	.interface_descriptor = &webusb_desc.if0,
	.cb_usb_status = webusb_dev_status_cb,
	.interface = {
		.class_handler = NULL,
		.custom_handler = webusb_custom_handle_req,
		.vendor_handler = webusb_vendor_handle_req,
	},
	.num_endpoints = ARRAY_SIZE(webusb_ep_data),
	.endpoint = webusb_ep_data
};
```

## src/webusb.h
```c
/*
 * Copyright (c) 2015-2019 Intel Corporation
 *
 * SPDX-License-Identifier: Apache-2.0
 */

/**
 * @file
 * @brief WebUSB enabled custom class driver header file
 *
 * Header file for WebUSB enabled custom class driver
 */

#ifndef __WEBUSB_SERIAL_H__
#define __WEBUSB_SERIAL_H__



#define MS_OS_DESCRIPTOR \
    0x12,                    /* Length */\
    0x03,                    /* Descriptor type: string */\
    'M' , 0x00, 'S' , 0x00,  /* Signature */\
    'F' , 0x00, 'T' , 0x00,  \
    '1' , 0x00, '0' , 0x00,  \
    '0' , 0x00,              \
    0x17,            /* Vendor code */\
    0x00                     /* Padding */

#define MS_OS_COMPATIDS(len, itfs) \
    len , 0x00, 0x00, 0x00,  /* Length */\
    0x00, 0x01,              /* Version */\
    0x04, 0x00,              /* Descriptor type: Compatibility ID */\
    itfs, 0x00,              /* Sections */\
    0x00, 0x00, 0x00, 0x00,  /* Reserved */\
    0x00, 0x00               /* Reserved */\

#define MS_OS_COMPATIDS_WINUSB \
    ITF_WEBUSB,              /* Interface index */\
    0x01,                    /* Reserved */\
    'W' , 'I' , 'N' , 'U' ,  /* Compat ID */\
    'S' , 'B' , 0x00, 0x00,  \
    0x00, 0x00, 0x00, 0x00,  /* Sub-compat ID. */\
    0x00, 0x00, 0x00, 0x00,  \
    0x00, 0x00, 0x00, 0x00,  /* Reserved */\
    0x00, 0x00               /* Reserved */\

#define MS_OS_COMPATIDS_XUSB \
    ITF_XINPUT,              /* Interface index */\
    0x01,                    /* Reserved */\
    'X' , 'U' , 'S' , 'B',   /* Compat ID */\
    '1' , '0' , 0x00, 0x00,  \
    0x00, 0x00, 0x00, 0x00,  /* Sub-compat ID. */\
    0x00, 0x00, 0x00, 0x00,  \
    0x00, 0x00, 0x00, 0x00,  /* Reserved */\
    0x00, 0x00               /* Reserved */

#define MS_OS_COMPATIDS_ALL \
    MS_OS_COMPATIDS(64,2), \
    MS_OS_COMPATIDS_WINUSB, \
    MS_OS_COMPATIDS_XUSB

#define MS_OS_COMPATIDS_GENERIC \
    MS_OS_COMPATIDS(40, 1), \
    MS_OS_COMPATIDS_WINUSB







/**
 * WebUSB request handlers
 */
struct webusb_req_handlers {
	/* Handler for WebUSB Vendor specific commands */
	usb_request_handler vendor_handler;
	/**
	 * The custom request handler gets a first chance at handling
	 * the request before it is handed over to the 'chapter 9' request
	 * handler
	 */
	usb_request_handler custom_handler;
};

/**
 * @brief Register Custom and Vendor request callbacks
 *
 * Function to register Custom and Vendor request callbacks
 * for handling requests.
 *
 * @param [in] handlers Pointer to WebUSB request handlers structure
 */
void webusb_register_request_handlers(struct webusb_req_handlers *handlers);

#endif /* __WEBUSB_SERIAL_H__ */
```

## src/xinput.c
```c
#define LOG_LEVEL CONFIG_USB_DEVICE_LOG_LEVEL
#include <zephyr/logging/log.h>
LOG_MODULE_REGISTER(xinput);

#include <zephyr/sys/byteorder.h>
#include <zephyr/usb/usb_device.h>
#include <usb_descriptor.h>

#include "xinput.h"

/* Max packet size for Bulk endpoints */
#if defined(CONFIG_USB_DC_HAS_HS_SUPPORT)
#define XINPUT_BULK_EP_MPS		512
#else
#define XINPUT_BULK_EP_MPS		32
#endif

/* Number of interfaces */
#define XINPUT_NUM_ITF			0x01
/* Number of Endpoints in the custom interface */
#define XINPUT_NUM_EP			0x02

#define XINPUT_IN_EP_IDX		0
#define XINPUT_OUT_EP_IDX		1

static struct xinput_req_handlers *req_handlers;
static struct xinput_in_struct{
	uint8_t report_id;
	uint8_t report_size;
	uint8_t buttons_0;
	uint8_t buttons_1;
	uint8_t lz;
	uint8_t rz;
	int16_t lx;
	int16_t ly;
	int16_t rx;
	int16_t ry;
	uint8_t reserved[6];
} __packed xinput_data = {
	.report_id   = 0,
	.report_size = 20,
	.buttons_0   = 0,
	.buttons_1   = 0,
	.lz          = 0,
	.rz          = 0,
	.lx          = 0,
	.ly          = 0,
	.rx          = 0,
	.ry          = 0,
	.reserved    = {0, 0, 0, 0, 0, 0}
};


uint8_t rx_buf[XINPUT_BULK_EP_MPS];

#define INITIALIZER_IF(num_ep)				\
	{								\
		.bLength = sizeof(struct usb_if_descriptor),		\
		.bDescriptorType = USB_DESC_INTERFACE,			\
		.bInterfaceNumber = 0,					\
		.bAlternateSetting = 0,					\
		.bNumEndpoints = num_ep,				\
		.bInterfaceClass = 0xFF,				\
		.bInterfaceSubClass = 0x5D,				\
		.bInterfaceProtocol = 0x01,				\
		.iInterface = 0,					\
	}

#define INITIALIZER_IF_EP(addr, attr, mps, interval)			\
	{								\
		.bLength = 0x07,		\
		.bDescriptorType = USB_DESC_ENDPOINT,			\
		.bEndpointAddress = addr,				\
		.bmAttributes = attr,					\
		.wMaxPacketSize = sys_cpu_to_le16(mps),			\
		.bInterval = interval,					\
	}

//0x10, 0x21, 0x10, 0x01, 0x01, 0x24, 0x81, 0x14, 0x03, 0x00, 0x03, 0x13, 0x02, 0x00, 0x03, 0x00,
USBD_CLASS_DESCR_DEFINE(primary, 0) struct {
	struct usb_if_descriptor if0;
	struct usb_ep_descriptor if0_in_ep;
	struct xbox_undefined_descriptor vndr;
	struct usb_ep_descriptor if0_out_ep;
	
} __packed xinput_desc = {
	.if0 = INITIALIZER_IF(0x02),
	.vndr = {
		.bLength = 0x10,
		.bDescriptorType = 0x21,
		.f1 = 0x10,
		.f2 = 0x01,
		.f3 = 0x01,
		.f4 = 0x24,
		.f5 = 0x81,
		.f6 = 0x14,
		.f7 = 0x03,
		.f8 = 0x00,
		.f9 = 0x03,
		.f10 = 0x13,
		.f11 = 0x01,
		.f12 = 0x00,
		.f13 = 0x03,
		.f14 = 0x00
	},
	.if0_in_ep = INITIALIZER_IF_EP(0x81, USB_DC_EP_INTERRUPT,
				       32, 0x04),
	.if0_out_ep = INITIALIZER_IF_EP(0x01, USB_DC_EP_INTERRUPT,
					32, 0x08),

};

/**
 * @brief Custom handler for standard requests in order to
 *        catch the request and return the Xinput Platform
 *        Capability Descriptor.
 *
 * @param pSetup    Information about the request to execute.
 * @param len       Size of the buffer.
 * @param data      Buffer containing the request result.
 *
 * @return  0 on success, negative errno code on fail.
 */
int xinput_custom_handle_req(struct usb_setup_packet *pSetup,
			     int32_t *len, uint8_t **data)
{
	LOG_DBG("");

	/* Call the callback */
	if (req_handlers && req_handlers->custom_handler) {
		return req_handlers->custom_handler(pSetup, len, data);
	}

	return -EINVAL;
}

/**
 * @brief Handler called for Xinput vendor specific commands.
 *
 * @param pSetup    Information about the request to execute.
 * @param len       Size of the buffer.
 * @param data      Buffer containing the request result.
 *
 * @return  0 on success, negative errno code on fail.
 */
int xinput_vendor_handle_req(struct usb_setup_packet *pSetup,
			     int32_t *len, uint8_t **data)
{
	/* Call the callback */
	if (req_handlers && req_handlers->vendor_handler) {
		return req_handlers->vendor_handler(pSetup, len, data);
	}

	return -EINVAL;
}

/**
 * @brief Register Custom and Vendor request callbacks
 *
 * This function registers Custom and Vendor request callbacks
 * for handling the device requests.
 *
 * @param [in] handlers Pointer to Xinput request handlers structure
 */
void xinput_register_request_handlers(struct xinput_req_handlers *handlers)
{
	req_handlers = handlers;
}

void xinput_out_cb(uint8_t ep, enum usb_dc_ep_cb_status_code ep_status)
{
	LOG_DBG("Out");
}

static int ctr=0;
 void xinput_in_cb(uint8_t ep, enum usb_dc_ep_cb_status_code ep_status)
{
	if(ctr==50){
		xinput_data.buttons_1 = 0b00010000;
		xinput_data.lx = -32000;
		xinput_data.ry = -32000;
		xinput_data.lz=255;
	}
	if(ctr==100){
		xinput_data.buttons_1 = 0x00;
		xinput_data.lx = 32000;
		xinput_data.ry = 32000;
		xinput_data.lz=0;
		ctr=0;
	}
	ctr+=1;
	if (usb_write(ep, (const uint8_t *)&xinput_data, sizeof xinput_data, NULL)) {
		LOG_INF("data IN success");
	}
}
/* Describe EndPoints configuration */
static struct usb_ep_cfg_data xinput_ep_data[] = {
	{
		.ep_cb = xinput_in_cb,
		.ep_addr = 0x81
	},
	{
		.ep_cb	= xinput_out_cb,
		.ep_addr = 0x01
	}
};

/**
 * @brief Callback used to know the USB connection status
 *
 * @param status USB device status code.
 */
static void xinput_dev_status_cb(struct usb_cfg_data *cfg,
				 enum usb_dc_status_code status,
				 const uint8_t *param)
{
	ARG_UNUSED(param);
	ARG_UNUSED(cfg);

	/* Check the USB status and do needed action if required */
	switch (status) {
	case USB_DC_ERROR:
		LOG_DBG("USB device error");
		break;
	case USB_DC_RESET:
		LOG_DBG("USB device reset detected");
		break;
	case USB_DC_CONNECTED:
		LOG_DBG("USB device connected");
		break;
	case USB_DC_CONFIGURED:
		LOG_INF("USB device configured");
		xinput_in_cb(xinput_ep_data[0].ep_addr, 0);
		break;
	case USB_DC_DISCONNECTED:
		LOG_DBG("USB device disconnected");
		break;
	case USB_DC_SUSPEND:
		LOG_DBG("USB device suspended");
		break;
	case USB_DC_RESUME:
		LOG_DBG("USB device resumed");
		break;
	case USB_DC_UNKNOWN:
	default:
		LOG_DBG("USB unknown state");
		break;
	}
}





USBD_DEFINE_CFG_DATA(xinput_config) = {
	.usb_device_description = NULL,
	.interface_descriptor = &xinput_desc.if0,
	.cb_usb_status = xinput_dev_status_cb,
	.interface = {
		.class_handler = NULL,
		.custom_handler = xinput_custom_handle_req,
		.vendor_handler = xinput_vendor_handle_req,
	},
	.num_endpoints = ARRAY_SIZE(xinput_ep_data),
	.endpoint = xinput_ep_data
};
```

## src/xinput.h
```c
#ifndef __XINPUT_H__
#define __XINPUT_H__



#define MS_OS_DESCRIPTOR \
    0x12,                    /* Length */\
    0x03,                    /* Descriptor type: string */\
    'M' , 0x00, 'S' , 0x00,  /* Signature */\
    'F' , 0x00, 'T' , 0x00,  \
    '1' , 0x00, '0' , 0x00,  \
    '0' , 0x00,              \
    0x17,            /* Vendor code */\
    0x00                     /* Padding */

#define MS_OS_COMPATIDS(len, itfs) \
    len , 0x00, 0x00, 0x00,  /* Length */\
    0x00, 0x01,              /* Version */\
    0x04, 0x00,              /* Descriptor type: Compatibility ID */\
    itfs, 0x00,              /* Sections */\
    0x00, 0x00, 0x00, 0x00,  /* Reserved */\
    0x00, 0x00               /* Reserved */\

#define MS_OS_COMPATIDS_WINUSB \
    ITF_WEBUSB,              /* Interface index */\
    0x01,                    /* Reserved */\
    'W' , 'I' , 'N' , 'U' ,  /* Compat ID */\
    'S' , 'B' , 0x00, 0x00,  \
    0x00, 0x00, 0x00, 0x00,  /* Sub-compat ID. */\
    0x00, 0x00, 0x00, 0x00,  \
    0x00, 0x00, 0x00, 0x00,  /* Reserved */\
    0x00, 0x00               /* Reserved */\

#define MS_OS_COMPATIDS_XUSB \
    ITF_XINPUT,              /* Interface index */\
    0x01,                    /* Reserved */\
    'X' , 'U' , 'S' , 'B',   /* Compat ID */\
    '1' , '0' , 0x00, 0x00,  \
    0x00, 0x00, 0x00, 0x00,  /* Sub-compat ID. */\
    0x00, 0x00, 0x00, 0x00,  \
    0x00, 0x00, 0x00, 0x00,  /* Reserved */\
    0x00, 0x00               /* Reserved */

#define MS_OS_COMPATIDS_ALL \
    MS_OS_COMPATIDS(64,2), \
    MS_OS_COMPATIDS_WINUSB, \
    MS_OS_COMPATIDS_XUSB

#define MS_OS_COMPATIDS_GENERIC \
    MS_OS_COMPATIDS(40, 1), \
    MS_OS_COMPATIDS_WINUSB







/**
 * Xinput request handlers
 */
struct xinput_req_handlers {
	/* Handler for Xinput Vendor specific commands */
	usb_request_handler vendor_handler;
	/**
	 * The custom request handler gets a first chance at handling
	 * the request before it is handed over to the 'chapter 9' request
	 * handler
	 */
	usb_request_handler custom_handler;
};

/**
 * @brief Register Custom and Vendor request callbacks
 *
 * Function to register Custom and Vendor request callbacks
 * for handling requests.
 *
 * @param [in] handlers Pointer to Xinput request handlers structure
 */
void xinput_register_request_handlers(struct xinput_req_handlers *handlers);

#endif /* __XINPUT_H__ */
```
